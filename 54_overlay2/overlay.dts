// 设备树版本
/dts-v1/;
// 插件
/plugin/;

// &{/typecoh/myirq}{
//     overlay_node{
//         status = "okay";
//     };
// };

// 这个leds 是 label
/*
leds: leds {
	compatible = "gpio-leds";
	rgb_led_r: rgb-led-r {
		gpios = <&gpio1 RK_PB2 GPIO_ACTIVE_LOW>;
		linux,default-trigger = "timer";
		linux,delay-reg = <0>;// 延时注册
		linux,blink-delay-on = <500>;// 打开时间
		linux,blink-delay-off = <500>;// 关闭时间
	};
	rgb_led_g: rgb-led-g {
		gpios = <&gpio1 RK_PB1 GPIO_ACTIVE_LOW>;
		linux,default-trigger = "timer";
		linux,delay-reg = <100>;// 延时注册
		linux,blink-delay-on = <1000>;
		linux,blink-delay-off = <1000>;
	};
	rgb_led_b: rgb-led-b {
		gpios = <&gpio1 RK_PB0 GPIO_ACTIVE_LOW>;
		linux,default-trigger = "timer";
		linux,delay-reg = <100>;// 延时注册
		linux,blink-delay-on = <1500>;
		linux,blink-delay-off = <1500>;
	};
};
*/
&leds {
	overlay_node{
		status = "okay";
	};
};
